## tools/batocera/rpi4/Config.in
```kconfig
config BR2_PACKAGE_3SX
	bool "3sx"
	depends on BR2_PACKAGE_SDL3
	select BR2_PACKAGE_ZLIB
	help
	  Street Fighter III: 3rd Strike port.

	  https://github.io.github.threestylextra.app
```
